## drivers/input/touchscreen/atmxt540s/Kconfig
```kconfig
config WMT_ATMXT540S_TOUCHSCREEN
        tristate "WonderMedia  ATMXT768 Touchscreen Device Support"
        default y
        depends on ARCH_WMT
        ---help---
          Say Y here if you have an WMT based board with touchscreen
          attached to it.
          If unsure, say N.
          To compile this driver as a module, choose M here: the
          module will be called ATMXT540S.

choice
    prompt "ATMXT540S TouchPanel interface Select"
config ATMXT540S_TS_I2C
        bool "I2C"
        ---help---
          Say Y here if you want to use I2C bus.
endchoice
```

## drivers/input/touchscreen/atmxt768/Kconfig
```kconfig
config WMT_ATMXT768_TOUCHSCREEN
        tristate "WonderMedia  ATMXT768 Touchscreen Device Support"
        default n
        depends on ARCH_WMT
        ---help---
          Say Y here if you have an WMT based board with touchscreen
          attached to it.
          If unsure, say N.
          To compile this driver as a module, choose M here: the
          module will be called ATMXT768.

choice
    prompt "ATMXT768 TouchPanel interface Select"
config ATMXT768_TS_I2C
        bool "I2C"
        ---help---
          Say Y here if you want to use I2C bus.
endchoice
```

## drivers/power/asus_battery/Kconfig
```kconfig
#
#  Copyright (c) 2012, ASUSTek, Inc. All Rights Reserved.
#  Written by wade chen Wade1_Chen@asus.com
#
#
#
# Input core configuration
#
menuconfig ASUS_BATTERY
	bool "ASUS Battery support"
	default y
	help
	  Say Y here, and a list of supported BQ27541 will be displayed.
	  This option doesn't affect the kernel.

	  If unsure, say Y.

if ASUS_BATTERY

config ASUS_BQ27520_BATTERY
	tristate "ASUS BQ27520 battery driver"
    default y
	help
	  Say Y here to enable support for batteries with BQ27520 (I2C) chips.

config ASUS_UG31XX_BATTERY
	tristate "ASUS UG31XX battery driver"
	help
	  Say Y here to enable support for batteries with UG31XX(I2C) chips.

config ASUS_FAKE_BATTERY
	tristate "ASUS fake battery driver"
    default y
	help
	  Say Y here to enable support for batteries with fake battery.

config ASUS_BAT_LOW_EVENT
        bool "Support battery low event"
        default n
	help
	  Say Y here, if you want to trigger battery low event by interrupt.

	  If unsure, say N.

endif #if ASUS_DRIVERS
```

## drivers/thermal/asus_thermal/Kconfig
```kconfig
menuconfig ASUS_THERMAL
	bool "ASUS thermal support"
	default y
	help
	  Say Y here, and a list of supported nct7717u will be displayed.
	  This option doesn't affect the kernel.

	  If unsure, say Y.

if ASUS_THERMAL

config ASUS_NCT7717U_THERMAL
	tristate "ASUS NCT7717 thermal driver"
        default y
	help
	  Say Y here to enable support for batteries with thermal (I2C) chips.

endif #if ASUS_THERMAL
```
